## fs/apfs/Kconfig
```kconfig
config APFS_FS
	tristate "APFS filesystem support"
	default y
	select LIBCRC32C
	select NLS
	help
	  This module provides a small degree of experimental support for the
	  Apple File System (APFS).

	  To compile this file system support as a module, choose M here: the
	  module will be called apfs.

	  If you want to use the APFS file systems, then you must say Y or M here
	  to inlucde APFS support.

config APFS_DEBUG
	bool "APFS debugging support"
	default n
	depends on APFS_FS
	help
	  Enable the debugging features for APFS. This may hurt performance,
	  so say N if you are not a developer.
```
